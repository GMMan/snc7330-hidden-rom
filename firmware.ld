/* Linker script for STM32F303 Cortex-M3 ARM MCU */

/* Define the memory mapping of the chip */
MEMORY
{
  pram    (rx)  : ORIGIN = 0x00000000, LENGTH = 64K
  sram    (rwx) : ORIGIN = 0x18000000, LENGTH = 128K
  icache  (rx)  : ORIGIN = 0x10000000, LENGTH = 1M
  mailbox (rw)  : ORIGIN = 0x20000000, LENGTH = 4K
  flash   (rx)  : ORIGIN = 0x60000000, LENGTH = 256M
}

/* Define some useful symbols that can be used from the code */
__rom_start__	= ORIGIN(pram);
__rom_size__	= LENGTH(pram);
__ram_start__	= ORIGIN(sram);
__ram_size__	= LENGTH(sram);
__ram_end__	= __ram_start__ + __ram_size__;


/* These are used to setup the C heap and stack */
/* The stack is at the top of RAM and grows downwards, it takes half the memory */
__stack_end__	= __ram_end__;		/* Top of RAM */

/* The heap is the remaining space in RAM when all the statics and the stacks are allocated.
 * It only gets used if you use malloc()/free(), anyway. */
__heap_start__	= __bss_end__;		/* Between bss and stack */

/* Now define the memory mapping. The section names in parentheses reflect the
 * sections generated by the compiler. The * means 'from all object files'. The
 * only case where you need to do otherwise is usually to setup the interrupt
 * vectors, if you need them at the start of flash or some other useful place.*/
SECTIONS
{
  . = 0;

  .note.gnu.build-id  : { *(.note.gnu.build-id) }
  .hash           : { *(.hash) }
  .gnu.hash       : { *(.gnu.hash) }
  .dynsym         : { *(.dynsym) }
  .dynstr         : { *(.dynstr) }
  .gnu.version    : { *(.gnu.version) }
  .gnu.version_d  : { *(.gnu.version_d) }
  .gnu.version_r  : { *(.gnu.version_r) }

	/* Here is the ROM */
  .load_table : {
    obj/sonix_load_table.o(.rodata*);
  } >flash

  .text : {
  KEEP(*(.boot*))				/* Reset vectors */
  *(.text*)				/* Program code */
  *(.rodata*)			/* Read only data */
  *(.glue_7)
  *(.glue_7t)
  *(.eh_frame)
  . = ALIGN(4);
  __ctors_start__ = .;
  KEEP(*(.init_array));			/* C++ constructors */
  KEEP(*(.ctors));			/* C++ constructors */
  __ctors_end__ = .;
  . = ALIGN(16);
  __text_end__ = .;
  } >pram AT >flash

  /* Initialized data is allocated in flash, but will be moved to RAM by the
   * boot code. */
  .data : ALIGN(16) {
  __data_beg__ = .;			/* Used in crt0.S */
  *(.data)				/* Initialized data */
  __data_end__ = .;			/* Used in crt0.S */
  } >sram AT >flash

  /* And here is all the uninitialized data. It will follow the initialized
   * part in RAM, and need not be copied from flash, only zero-cleared. */
  .bss (NOLOAD) : ALIGN(16) {
  __bss_beg__ = .;			/* Used in crt0.S */
  *(.bss)				/* Uninitialized data */
  *(COMMON)				/* Common data */
  __bss_end__ = .;			/* Used in crt0.S */
  } >sram

  /* C++ exception unwinding stuff--needed by some toolchains */

  .ARM.extab : { *(.ARM.extab* .gnu.linkonce.armextab.*) } >pram AT >flash

  __exidx_start = .;
  .ARM.exidx : { *(.ARM.exidx* .gnu.linkonce.armexidx.*) } >pram AT >flash
  __exidx_end = .;

  /* Stabs debugging sections.  */
  .stab          0 : { *(.stab) }
  .stabstr       0 : { *(.stabstr) }
  .stab.excl     0 : { *(.stab.excl) }
  .stab.exclstr  0 : { *(.stab.exclstr) }
  .stab.index    0 : { *(.stab.index) }
  .stab.indexstr 0 : { *(.stab.indexstr) }
  .comment 0 (INFO) : { *(.comment); LINKER_VERSION; }
  .gnu.build.attributes : { *(.gnu.build.attributes .gnu.build.attributes.*) }
  /* DWARF debug sections.
     Symbols in the DWARF debugging sections are relative to the beginning
     of the section so we begin them at 0.  */
  /* DWARF 1.  */
  .debug          0 : { *(.debug) }
  .line           0 : { *(.line) }
  /* GNU DWARF 1 extensions.  */
  .debug_srcinfo  0 : { *(.debug_srcinfo) }
  .debug_sfnames  0 : { *(.debug_sfnames) }
  /* DWARF 1.1 and DWARF 2.  */
  .debug_aranges  0 : { *(.debug_aranges) }
  .debug_pubnames 0 : { *(.debug_pubnames) }
  /* DWARF 2.  */
  .debug_info     0 : { *(.debug_info .gnu.linkonce.wi.*) }
  .debug_abbrev   0 : { *(.debug_abbrev) }
  .debug_line     0 : { *(.debug_line .debug_line.* .debug_line_end) }
  .debug_frame    0 : { *(.debug_frame) }
  .debug_str      0 : { *(.debug_str) }
  .debug_loc      0 : { *(.debug_loc) }
  .debug_macinfo  0 : { *(.debug_macinfo) }
  /* SGI/MIPS DWARF 2 extensions.  */
  .debug_weaknames 0 : { *(.debug_weaknames) }
  .debug_funcnames 0 : { *(.debug_funcnames) }
  .debug_typenames 0 : { *(.debug_typenames) }
  .debug_varnames  0 : { *(.debug_varnames) }
  /* DWARF 3.  */
  .debug_pubtypes 0 : { *(.debug_pubtypes) }
  .debug_ranges   0 : { *(.debug_ranges) }
  /* DWARF 5.  */
  .debug_addr     0 : { *(.debug_addr) }
  .debug_line_str 0 : { *(.debug_line_str) }
  .debug_loclists 0 : { *(.debug_loclists) }
  .debug_macro    0 : { *(.debug_macro) }
  .debug_names    0 : { *(.debug_names) }
  .debug_rnglists 0 : { *(.debug_rnglists) }
  .debug_str_offsets 0 : { *(.debug_str_offsets) }
  .debug_sup      0 : { *(.debug_sup) }
  .ARM.attributes 0 : { KEEP (*(.ARM.attributes)) KEEP (*(.gnu.attributes)) }
  .note.gnu.arm.ident 0 : { KEEP (*(.note.gnu.arm.ident)) }
  /DISCARD/ : { *(.note.GNU-stack) *(.gnu_debuglink) *(.gnu.lto_*) }
}
